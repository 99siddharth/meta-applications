## conf/layer.conf
```bitbake
# We have a conf and classes directory, add to BBPATH
BBPATH .= ":${LAYERDIR}"

# We have recipes-* directories, add to BBFILES
BBFILES += "${LAYERDIR}/recipes-*/*/*.bb \
            ${LAYERDIR}/recipes-*/*/*.bbappend"

BBFILE_COLLECTIONS += "meta-applications"
BBFILE_PATTERN_meta-applications = "^${LAYERDIR}/"
BBFILE_PRIORITY_meta-applications = "6"

LAYERDEPENDS_meta-applications = "core"
LAYERSERIES_COMPAT_meta-applications = "warrior zeus"
```
